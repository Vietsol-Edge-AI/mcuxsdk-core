## drivers/pdcon/Kconfig
```kconfig
# Copyright 2025 NXP
#
# SPDX-License-Identifier: BSD-3-Clause

config MCUX_HAS_COMPONENT_driver.pdcon
    bool
    default y if MCUX_HW_IP_DriverType_PDCON

config MCUX_COMPONENT_driver.pdcon
    bool "pdcon"
    select MCUX_COMPONENT_driver.common
    depends on MCUX_HAS_COMPONENT_driver.pdcon

if MCUX_COMPONENT_driver.pdcon
    config PDCON_BUSY_TIMEOUT
        int "Max loops to wait for PDCON to stop being busy (0 means wait forever)"
        default 0
        help
        The BUSY flag for specific power domain will be set when start any transition, will
        auto cleared once transition finished.
endif
```

## drivers/spdif_xcvr/Kconfig
```kconfig
# Copyright 2024-2025 NXP
#
# SPDX-License-Identifier: BSD-3-Clause

config MCUX_HAS_COMPONENT_driver.spdif_xcvr
    bool
    default y if MCUX_HW_IP_DriverType_SPDIF_XCVR

config MCUX_COMPONENT_driver.spdif_xcvr
    bool "spdif_xcvr"
    select MCUX_COMPONENT_driver.common
    depends on MCUX_HAS_COMPONENT_driver.spdif_xcvr
```

## drivers/spi_filter/Kconfig
```kconfig
# Copyright 2026 NXP
#
# SPDX-License-Identifier: BSD-3-Clause

config MCUX_HAS_COMPONENT_driver.spi_filter
    bool
    default y if MCUX_HW_IP_DriverType_SPIFILTER

config MCUX_COMPONENT_driver.spi_filter
    bool "spi_filter"
    depends on MCUX_HAS_COMPONENT_driver.spi_filter
```

## drivers/tenbaset_phy/Kconfig
```kconfig
# Copyright 2025 NXP
#
# SPDX-License-Identifier: BSD-3-Clause

config MCUX_HAS_COMPONENT_driver.tenbaset_phy
    bool
    default y if MCUX_HW_IP_DriverType_TENBASET_PHY

config MCUX_COMPONENT_driver.tenbaset_phy
    bool "tenbaset_phy"
    select MCUX_COMPONENT_driver.common
    depends on MCUX_HAS_COMPONENT_driver.tenbaset_phy

if MCUX_COMPONENT_driver.tenbaset_phy

    config TENBASET_PHY_MODE_TIMEOUT
        int "TENBASET_PHY Mode Transition Timeout"
        default 1000000
        help
          type unsigned
          Timeout for TENBASET_PHY mode transitions in microseconds.

    config TENBASET_PHY_RESET_TIMEOUT
        int "TENBASET_PHY Reset Timeout"
        default 100000
        help
          type unsigned
          Timeout for TENBASET_PHY reset operation in microseconds.

    config TENBASET_PHY_SMI_TIMEOUT
        int "TENBASET_PHY SMI Ready Timeout"
        default 1000
        help
          type unsigned
          Timeout for TENBASET_PHY Serial Management Interface (SMI)
          ready state in loop cycles.

endif
```

## drivers/trgsync/Kconfig
```kconfig
# Copyright 2025 NXP
#
# SPDX-License-Identifier: BSD-3-Clause

config MCUX_HAS_COMPONENT_driver.trgsync
    bool
    default y if MCUX_HW_IP_DriverType_TRGSYNC

config MCUX_COMPONENT_driver.trgsync
    bool "trgsync"
    select MCUX_COMPONENT_driver.common
    depends on MCUX_HAS_COMPONENT_driver.trgsync
```
